## boards/sf32lb52/drivers/audio/Kconfig
```kconfig
#
# For a description of the syntax of this configuration file,
# see the file kconfig-language.txt in the NuttX tools repository.
#

config SIFLI_AUDCODEC
	bool "SiFli SF32LB52 on-chip audio codec (DAC playback)"
	default n
	---help---
		Minimal driver for the SF32LB52 on-chip AUDCODEC DAC path
		(speaker output), including DMA playback.

		Clock parameters follow the official SF32LB52X table: clk_div is
		always 1 on 52x and sinc_gain is 0x14D for a 3.3V AVDD.

if SIFLI_AUDCODEC

config SIFLI_AUDCODEC_PA_PIN
	int "Audio PA enable GPIO pin (GPIO1/PA bank)"
	default 10
	---help---
		PA10 = AUDIO_PA_CTRL on sf32lb52_devkit_lcd (NS4150B amplifier,
		active high).

		NOTE: on sf32lb52_lchspi_ulp and lckfb_huangshan_pi PA10 is
		I2C2_SCL, so this must be adjusted for those boards.

config SIFLI_AUDCODEC_TESTAPPS
	bool "Build audtest / wavplay test applications"
	default y
	---help---
		audtest  - staged tone tests (square / sine / DMA / sweep)
		wavplay  - play a 16-bit PCM .wav file

		Enabling this also embeds a small test .wav into the board romfs.

endif
```

## boards/sf32lb52/drivers/input/Kconfig
```kconfig
#
# For a description of the syntax of this configuration file,
# see the file kconfig-language.txt in the NuttX tools repository.
#

config INPUT_FT6146
	bool "FocalTech FT6146 touchscreen controller"
	default n
	depends on INPUT && I2C && INPUT_TOUCHSCREEN
	---help---
		Enable support for the FocalTech FT6146 touchscreen controller.

if INPUT_FT6146

config TOUCH_IRQ_PIN
	int "Touch IRQ pin number"
	default 31
	---help---
		Driver GPIO pin id used by sifli_gpio_set_event().
		PA31 is 31 on this board.

config INPUT_FT6146_POLL_MS
	int "Touch poll interval in milliseconds (0 to disable)"
	default 0
	---help---
		Poll the controller every N milliseconds in addition to the edge
		interrupt, for boards where the CTP interrupt pad cannot be used as
		an edge source.  The driver collapses repeated states, so running
		both sources produces no duplicate events.  Note that the panel does
		not answer while idle -- each idle poll costs a full I2C timeout, so
		leave this at 0 whenever the interrupt works.

config INPUT_FT6146_TRACE
	bool "Log touch samples to syslog"
	default n
	---help---
		Print the chip id at init and one line per reported sample,
		including the interrupt count.  Diagnostic use only.

endif
```

## boards/sf32lb52/drivers/lcd/Kconfig
```kconfig
#
# For a description of the syntax of this configuration file,
# see the file kconfig-language.txt in the NuttX tools repository.
#

menuconfig SIFLI_LCD
    bool "SiFli Display Driver"
    default n

if SIFLI_LCD
    config LCD_USING_ILI8688E
        bool
        default n

    config LCD_USING_EPD_SPI
        bool
        default n

    config BSP_LCDC_USING_SPI_NODCX_1DATA
        def_bool n 
    config BSP_LCDC_USING_SPI_NODCX_2DATA
        def_bool n 
    config BSP_LCDC_USING_SPI_DCX_1DATA
        def_bool n 
    config BSP_LCDC_USING_SPI_DCX_2DATA
        def_bool n 
    config BSP_LCDC_USING_QADSPI
        def_bool n 
    config BSP_LCDC_USING_DBI
        def_bool n 
    config BSP_LCDC_USING_DSI
        def_bool n
    config BSP_LCDC_USING_DPI
        def_bool n
    config BSP_USING_RAMLESS_LCD
        def_bool n
    config BSP_LCDC_USING_JDI_PARALLEL
        def_bool n

    config LCD_USING_PWM_AS_BACKLIGHT
        def_bool n

    config BSP_LCDC1_USE_LCDC2_TE
        def_bool n

    config BSP_USE_LCDC2_ON_HPSYS
        def_bool n

    config BSP_USING_ROUND_TYPE_LCD
        def_bool n

    config BSP_USING_RECT_TYPE_LCD
        def_bool n



    choice
        prompt "Select LCD"
        default LCD_USING_ED_LB55BILI8688E

        config LCD_USING_ED_LB55BILI8688E
            bool "1.78 rect QAD-SPI LCD(ED-LB55DSI17801 - Green)"
            select LCD_USING_ILI8688E
            select TSC_USING_CST918 if BSP_USING_TOUCHD
            select BSP_LCDC_USING_QADSPI
            select BSP_USING_RECT_TYPE_LCD
            if LCD_USING_ED_LB55BILI8688E
               config LCD_ILI8688E_VSYNC_ENABLE
                    bool "Enable LCD VSYNC (TE signal)"
                    def_bool y
            endif

        config LCD_USING_CO5300
            bool "1.85 rect QSPI Single-Screen LCD(LCD_1P85_390*450_DevKit_Adapter_V1.0.0)"
            select BSP_LCDC_USING_QADSPI
            select LCD_USING_PWM_AS_BACKLIGHT
            select BSP_USING_RECT_TYPE_LCD
            if LCD_USING_CO5300
               config LCD_CO5300_VSYNC_ENABLE
                    bool "Enable LCD VSYNC (TE signal)"
                    def_bool y

                   config LCD_CO5300_BW_TEST_MODE
                    bool "Enable CO5300 Black/White Test On Boot"
                    default n
            endif

            config LCD_USING_SF32LB52_EPD
                bool "528x792 SPI E-Paper Display"
                select LCD_USING_EPD_SPI
                select BSP_LCDC_USING_SPI_DCX_1DATA
                select BSP_USING_RECT_TYPE_LCD

    endchoice

    config LCD_HOR_RES_MAX
        int
        default 368 if LCD_USING_ED_LB55BILI8688E
        default 390 if LCD_USING_CO5300
        default 528 if LCD_USING_SF32LB52_EPD

        
    config LCD_VER_RES_MAX
        int
        default 448 if LCD_USING_ED_LB55BILI8688E
        default 450 if LCD_USING_CO5300
        default 792 if LCD_USING_SF32LB52_EPD


    config LCD_DPI
        int
        default 315 if LCD_USING_ED_LB55BILI8688E
        default 315 if LCD_USING_CO5300
        default 160 if LCD_USING_SF32LB52_EPD

    menu "LVGL&LCD framebuffer configuration"

        config BSP_USING_LCD_FRAMEBUFFER
            bool "Enable SiFli LCDC framebuffer manager"
            default n
            help
                Enable the driver-side framebuffer manager used by LVGL partial
                rendering. This mirrors the RT drv_lcd_fb.c path.

        config DRV_LCD_COMPRESSED_BUF_AVALIABLE
            bool
            default y if BSP_USING_EXT_DMA

        comment "------------1. Config LCD framebuffer on PSRAM-----------"

        choice
            prompt "LCD Framebuffer config"
            default LCD_FB_USING_TWO_UNCOMPRESSED
            help
                LCD framebuffer is used to buffer the LVGL framebuffer and
                retain the full image of the LCD screen. This prevents tearing
                caused by slow rendering.

            config LCD_FB_USING_ONE_UNCOMPRESSED
                bool "One screen sized buffer"
                select BSP_USING_LCD_FRAMEBUFFER

            config LCD_FB_USING_TWO_UNCOMPRESSED
                bool "Two screen sized buffer for ramless LCD typically"
                select BSP_USING_LCD_FRAMEBUFFER

            config LCD_FB_USING_ONE_COMPRESSED
                bool "One screen sized compressed buffer"
                select BSP_USING_LCD_FRAMEBUFFER
                depends on DRV_LCD_COMPRESSED_BUF_AVALIABLE

            config LCD_FB_USING_TWO_COMPRESSED
                bool "Two screen sized compressed buffer for ramless LCD typically"
                select BSP_USING_LCD_FRAMEBUFFER
                depends on DRV_LCD_COMPRESSED_BUF_AVALIABLE

            config LCD_FB_USING_NONE
                bool "No Framebuffer, flush LVGL buffer to LCD directly"
        endchoice

        comment "------------2. Config LVGL framebuffer on SRAM-----------"

        choice
            prompt "LVGL Framebuffer config"
            default LV_FB_ONE_NOT_SCREEN_SIZE

            config LV_FB_ONE_SCREEN_SIZE
                bool "One screen sized framebuffer"
                select BSP_USING_LCD_FRAMEBUFFER

            config LV_FB_TWO_SCREEN_SIZE
                bool "TWO screen sized framebuffer"

            config LV_FB_ONE_NOT_SCREEN_SIZE
                bool "One part of framebuffer (1*LV_FB_LINE_NUM)"

            config LV_FB_TWO_NOT_SCREEN_SIZE
                bool "Two part of framebuffer (2*LV_FB_LINE_NUM)"
        endchoice

        config LV_FB_LINE_NUM
            int "LVGL Frame Buffer Line Number(LV_FB_LINE_NUM)"
            depends on LV_FB_ONE_NOT_SCREEN_SIZE || LV_FB_TWO_NOT_SCREEN_SIZE
            default 100

    endmenu

endif
```

## boards/sf32lb52/lckfb_huangshan_pi/Kconfig
```kconfig
config BOARD_AUDIO_SF32LB
	bool "SF32LB52 onboard audio (DAC + Class-D PA)"
	default n
	depends on BSP_ENABLE_AUD_CODEC
	---help---
		Enable onboard audio output via AUDCODEC DAC and PA42-controlled
		Class-D amplifier on the LCKFB Huangshan Pi board.
```

## boards/sf32lb52/sf32lb52_lchspi_ulp/Kconfig
```kconfig
config LV_USE_SIFLI_EPIC_IMAGE_SRAM_STAGE
	bool "Stage immutable SiFli EPIC images in SRAM"
	depends on LV_USE_SIFLI_EPIC
	default y
	help
	  Copy supported immutable RGB565/RGB565A8 variable images to an internal
	  SRAM staging buffer before EPIC drawing. This also enables transformed
	  RGB565A8 images to use EPIC instead of the software fallback.
```
